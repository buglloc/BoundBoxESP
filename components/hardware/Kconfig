## components/hardware/Kconfig
```kconfig
menu "BoundBox Hardware"

  menuconfig BBHW_HAS_ETH
    bool "Setup Ethernet"
    default y

  if BBHW_HAS_ETH

  config BBHW_ETH_PHY_ADDR
    int "Ethernet phy addr"
    range 0 46
    default 1

  config BBHW_ETH_SPI_CLOCK_MHZ
    int "Ethernet spi clock (MHz)"
    default 36

  config BBHW_ETH_CS_GPIO
    int "Ethernet CS gpio"
    range 0 46
    default 10

  config BBHW_ETH_INT_GPIO
    int "Ethernet INT gpio"
    range 1 46
    default 14

  config BBHW_ETH_RST_GPIO
    int "Ethernet RST gpio"
    range 1 46
    default 15

  endif # BBHW_HAS_ETH

  menuconfig BBHW_SPI_SETUP_SPI
    bool "Setup SPI"
    default y if BBHW_HAS_ETH

  if BBHW_SPI_SETUP_SPI

  choice BBHW_SPI_HOST
    prompt "SPI Host id to use"
    default BBHW_USE_SPI3_HOST

    config BBHW_USE_SPI2_HOST
      bool "SPI2_HOST"

    config BBHW_USE_SPI3_HOST
      bool "SPI3_HOST"
  endchoice

  config BBHW_SPI_HOST_ID
    int
    default 1 if BBHW_USE_SPI2_HOST
    default 2 if BBHW_USE_SPI3_HOST

  config BBHW_SPI_MOSI_GPIO
    int "Peripheral MOSI gpio"
    range 0 46
    default 11

  config BBHW_SPI_MISO_GPIO
    int "Peripheral MISO gpio"
    range 0 46
    default 13

  config BBHW_SPI_SCLK_GPIO
    int "Peripheral SCLK gpio"
    range 0 46
    default 12

  endif # BBHW_SPI_SETUP_SPI

endmenu
```

## components/peripheral/Kconfig
```kconfig
menu "BoundBox Peripheral"

  choice BBP_SPI_HOST_ID
    prompt "SPI Host id to use"
    default BBP_USE_SPI3_HOST

    config BBP_USE_SPI2_HOST
      bool "SPI2_HOST"

    config BBP_USE_SPI3_HOST
      bool "SPI3_HOST"
  endchoice

  config BBP_SPI_MOSI_GPIO
    int "Peripheral MOSI gpio"
    range 0 46
    default 11

  config BBP_SPI_MISO_GPIO
    int "Peripheral MISO gpio"
    range 0 46
    default 13

  config BBP_SPI_SCLK_GPIO
    int "Peripheral MOSI gpio"
    range 0 46
    default 12

  config BBP_HAS_ETH
    bool "Has ethernet"
    default y

  config BBP_ETH_PHY_ADDR
    int "Ethernet phy addr"
    range 0 46
    default 1
    depends on BBP_HAS_ETH

  config BBP_ETH_SPI_CLOCK_MHZ
    int "Ethernet spi click (mhz)"
    default 20
    depends on BBP_HAS_ETH

  config BBP_ETH_CS_GPIO
    int "Ethernet CS gpio"
    range 0 46
    default 10
    depends on BBP_HAS_ETH

  config BBP_ETH_INT_GPIO
    int "Ethernet INT gpio"
    range 0 46
    default 15
    depends on BBP_HAS_ETH

  config BBP_ETH_RST_GPIO
    int "Ethernet RST gpio"
    range 0 46
    default 16
    depends on BBP_HAS_ETH

  config BBP_HAS_WIFI
    bool "Has WiFi"
    default y

  choice BBP_NETKIND
    prompt "Default network implementation"
    default BBP_NETKIND_ETH

    config BBP_NETKIND_ETH
      bool "Ethernet"
      depends on BBP_HAS_ETH

    config BBP_NETKIND_WIFI_STA
      bool "WiFi"
      depends on BBP_HAS_WIFI
  endchoice

  config BBP_HOSTNAME
    string "Default hostname"
    default "BoundBoxESP"

  config BBP_NET_USE_STATIC_IP
    bool "Use static IP"
    default n

  config BBP_NET_IP
    string "Static IP to use"
    depends on BBP_NET_USE_STATIC_IP

  config BBP_NET_SUBNET
    string "Static Subnet to use"
    depends on BBP_NET_USE_STATIC_IP

  config BBP_NET_GW
    string "Static Gateway to use"
    depends on BBP_NET_USE_STATIC_IP

  config BBP_NET_DNS
    string "Static DNS to use"
    depends on BBP_NET_USE_STATIC_IP

  config BBP_WIFI_SSID
    string "WiFi SSID"
    default "BuggIOT"
    depends on BBP_NETKIND_WIFI_STA

  config BBP_WIFI_PASSWORD
    string "WiFi Password"
    depends on BBP_NETKIND_WIFI_STA

endmenu
```

## components/preferences/Kconfig
```kconfig
menu "BoundBox Preferences"

  config BB_PREF_NAMESPACE
    string "Namespace"
    default "bb_preferences"

endmenu
```

## components/ui/Kconfig
```kconfig
menu "BoundBox UI"

  config UI_PERIOD_TIME_MS
    int "UI update period time (ms)"
    range 5 100
    default 60

  config UI_LONG_PRESS_TIME_MS
    int "Button long press time (ms)"
    range 100 5000
    default 500

  config UI_SCENE_IDLE_TTL_MS
    int "Scene idle state TTL (ms)"
    range 500 50000
    default 1000

  config UI_UPDATE_INFO_PERIOD_MS
    int "UI update board info period time (ms)"
    range 50 5000
    default 500

  config UI_DEFAULT_BRIGHTNESS
    int "Default screen brightness"
    range 50 200
    default 75

endmenu
```

## main/Kconfig
```kconfig
menu "BoundBox Runtime"

  choice HOSTKEY_TYPE
    prompt "Default host key type"
    default HOSTKEY_TYPE_ED25519

    config HOSTKEY_TYPE_RSA
      bool "RSA (may be broken, not tested)"

    config HOSTKEY_TYPE_ECDSA
      bool "ECDSA (may be broken, not tested)"

    config HOSTKEY_TYPE_ED25519
      bool "ED25519"

  endchoice

  config HOSTKEY_RSA_BITS
    int "RSA key bits"
    default 2048
    depends on HOSTKEY_TYPE_RSA

  config HOSTKEY_ECDSA_BITS
    int "ECDSA key bits"
    default 256
    depends on HOSTKEY_TYPE_ECDSA

  config SECRET_KEY_SIZE
    int "Default secret key size"
    default 32

  config SSHD_TASK_STACK_SIZE
    int "SSHD task stack size"
    default 32768

  config COMMAND_BUFFER_SIZE
    int "Command buffer size"
    default 16384

  config SHUTDOWN_ON_ASSERT
    bool "Use shutdown instead of assert (board will be available after manual rst)"
    default false

  config DEFAULT_RESTART_DELAY_MS
    int "Default restart delay (ms)"
    range 0 100000
    default 2000

endmenu
```

## main/Kconfig.projbuild
```kconfig
menu "BoundBox"

  config ROOT_USERNAME
    string "Root username"
    default "root"

  config ROOT_KEY
    string "Root user authorized key"
    default ""

  config HOSTNAME
    string "Hostname"
    default "BoundBoxESP"

  choice NET_KIND
    prompt "Network implementation"
    default NET_KIND_USB

    config NET_KIND_USB
      bool "USB"

    config NET_KIND_WIFI_STA
      bool "WiFi"

    config NET_KIND_ETH
      bool "Ethernet"
      depends on BBHW_HAS_ETH
  endchoice

  choice NET_DHCP_KIND
    prompt "DHCP"
    default NET_DHCP_KIND_SERVER if NET_KIND_USB
    default NET_DHCP_KIND_CLIENT if NET_KIND_WIFI_STA
    default NET_DHCP_KIND_CLIENT if NET_KIND_ETH

    config NET_DHCP_KIND_NONE
      bool "None"

    config NET_DHCP_KIND_CLIENT
      bool "Client"

    config NET_DHCP_KIND_SERVER
      depends on !NET_KIND_WIFI_STA
      bool "Server (will use static IP)"
  endchoice

  menu "Static IP"
    depends on NET_DHCP_KIND_NONE || NET_DHCP_KIND_SERVER

    config NET_USE_STATIC_IP
      bool
      depends on NET_DHCP_KIND_NONE || NET_DHCP_KIND_SERVER
      default y

    config NET_IP
      string "IP"
      depends on NET_USE_STATIC_IP
      default "192.168.8.1"

    config NET_SUBNET
      string "Subnet"
      depends on NET_USE_STATIC_IP
      default "255.255.255.0"

    config NET_GW
      string "Gateway"
      depends on NET_USE_STATIC_IP
      default "192.168.8.1"

    config NET_DNS
      depends on NET_USE_STATIC_IP
      string "Primary DNS"

  endmenu

  menu "WiFi"
    depends on NET_KIND_WIFI_STA

    config WIFI_SSID
      depends on NET_KIND_WIFI_STA
      string "SSID"

    config WIFI_PASSWORD
      depends on NET_KIND_WIFI_STA
      string "Password"

  endmenu

  config PIN_VERIFICATION_SALT
    string "PIN verification salt"
    default "BoundBoxVerify"

  config DUMPABLE_SECRETS
    bool "Allow to read secrets by sysops"
    default false

  config HMAC_MIN_SALT_LEN
    int "Minimum salt len for HMAC secrets"
    range 1 256
    default 16

endmenu
```
