## components/ssh/Kconfig
```kconfig
menu "SSH Server"

  config SSH_SERVER_PORT
    int "Server port to listen to"
    range 0 32000
    default 22

  config SSH_SERVER_BACKLOG
    int "Socket backlog size"
    range 1 46
    default 5

  config SSH_STREAM_WRITE_BUFFER_SIZE
    int "Stream write buffer size"
    default 4096

  config SSH_STREAM_READ_BUFFER_SIZE
    int "Stream read buffer size"
    default 256

  config SSH_STREAM_POLL_TIMEOUT
    int "Stream poll timeout (ms)"
    default 100

  config SSH_STREAM_READ_TIMEOUT
    int "Stream read timeout (ms)"
    default 5000

  config SSH_AUTH_RETRIES
    int "Auth retries"
    default 10

endmenu
```

## sdkconfig.defaults
```kconfig
CONFIG_ESPTOOLPY_FLASHFREQ_80M=y
CONFIG_ESPTOOLPY_FLASHFREQ="80m"
CONFIG_ESPTOOLPY_FLASHSIZE_16MB=y
CONFIG_ESPTOOLPY_FLASHSIZE="16MB"

CONFIG_ESP_DEFAULT_CPU_FREQ_MHZ_240=y
CONFIG_ESP_DEFAULT_CPU_FREQ_MHZ=240

CONFIG_PARTITION_TABLE_CUSTOM=y
CONFIG_PARTITION_TABLE_CUSTOM_FILENAME="partitions.csv"
CONFIG_PARTITION_TABLE_FILENAME="partitions.csv"
CONFIG_PARTITION_TABLE_OFFSET=0xC000
CONFIG_PARTITION_TABLE_MD5=y

CONFIG_SPIRAM=y
CONFIG_SPIRAM_MODE_QUAD=n
CONFIG_SPIRAM_MODE_OCT=y
CONFIG_SPIRAM_TRY_ALLOCATE_WIFI_LWIP=y
CONFIG_SPIRAM_SPEED_80M=y
CONFIG_SPIRAM_SPEED=80

CONFIG_TINYUSB_NET_MODE_NONE=n
CONFIG_TINYUSB_NET_MODE_NCM=y
CONFIG_TINYUSB_DESC_MANUFACTURER_STRING="BoundBox"
CONFIG_TINYUSB_DESC_PRODUCT_STRING="Ethernet"
CONFIG_TINYUSB_DESC_SERIAL_STRING="31337"

CONFIG_LWIP_LOCAL_HOSTNAME="BoundBox"
CONFIG_ETH_SPI_ETHERNET_W5500=y

CONFIG_ESP_MAIN_TASK_STACK_SIZE=7168

CONFIG_LV_CONF_SKIP=y
CONFIG_LV_USE_FLOAT=y

CONFIG_ESP_CONSOLE_UART_DEFAULT=n
CONFIG_ESP_CONSOLE_UART_CUSTOM=y
CONFIG_ESP_CONSOLE_UART_CUSTOM_NUM_0=n
CONFIG_ESP_CONSOLE_UART_CUSTOM_NUM_1=y
CONFIG_ESP_CONSOLE_UART_NUM=1
CONFIG_ESP_CONSOLE_UART_TX_GPIO=43
CONFIG_ESP_CONSOLE_UART_RX_GPIO=44
CONFIG_ESP_CONSOLE_UART_BAUDRATE=115200
```
